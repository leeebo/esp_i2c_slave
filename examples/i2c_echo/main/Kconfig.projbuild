## examples/i2c_echo/main/Kconfig.projbuild
```kconfig
menu "Example Configuration"

    menu "I2C Master"

        orsource "$IDF_PATH/examples/common_components/env_caps/$IDF_TARGET/Kconfig.env_caps"

        config I2C_MASTER_SCL
            int "SCL GPIO Num"
            default 2 if  IDF_TARGET_ESP32S3 || IDF_TARGET_ESP32H2
            default 19 if IDF_TARGET_ESP32 || IDF_TARGET_ESP32S2
            default 6
            help
                GPIO number for I2C Master clock line.

        config I2C_MASTER_SDA
            int "SDA GPIO Num"
            default 1 if  IDF_TARGET_ESP32S3 || IDF_TARGET_ESP32H2
            default 18 if IDF_TARGET_ESP32 || IDF_TARGET_ESP32S2
            default 5
            help
                GPIO number for I2C Master data line.

        config I2C_MASTER_PORT_NUM
            int "Port Number"
            default 1 if SOC_I2C_NUM > 1
            default 0
            help
                Port number for I2C Master device.

        config I2C_MASTER_FREQUENCY
            int "Master Frequency"
            default 100000
            help
                I2C Speed of Master device.
    endmenu

    menu "I2C Slave"
        depends on SOC_I2C_NUM > 1
        config I2C_SLAVE_SCL
            int "SCL GPIO Num"
            default 5
            help
                GPIO number for I2C Slave clock line.

        config I2C_SLAVE_SDA
            int "SDA GPIO Num"
            default 4
            help
                GPIO number for I2C Slave data line.

        config I2C_SLAVE_PORT_NUM
            int "Port Number"
            default 0
            help
                Port number for I2C Slave device.

        config I2C_SLAVE_ADDRESS
            hex "ESP Slave Address"
            default 0x28
            help
                Hardware Address of I2C Slave Port.
    endmenu

endmenu
```
